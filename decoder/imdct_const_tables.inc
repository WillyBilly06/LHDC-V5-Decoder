static const float s_w1_r[64] = {
    1.0f, 1.0f, 1.0f, 1.0f, 1.0f, 1.0f, 1.0f, 1.0f,
    1.0f, 0.707106781f, 6.123234e-17f, -0.707106781f, -1.0f, -0.707106781f, -1.8369702e-16f, 0.707106781f,
    1.0f, 6.123234e-17f, -1.0f, -1.8369702e-16f, 1.0f, 3.061617e-16f, -1.0f, -4.2862638e-16f,
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    1.0f, 0.707106781f, -4.2862638e-16f, -0.707106781f, -1.0f, -0.707106781f, -4.904777e-16f, 0.707106781f,
};
static const float s_w1_i[64] = {
    -0.0f, -0.0f, -0.0f, -0.0f, -0.0f, -0.0f, -0.0f, -0.0f,
    -0.0f, -0.707106781f, -1.0f, -0.707106781f, -1.2246468e-16f, 0.707106781f, 1.0f, 0.707106781f,
    -0.0f, -1.0f, -1.2246468e-16f, 1.0f, 2.4492936e-16f, -1.0f, -3.6739404e-16f, 1.0f,
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    -0.0f, 0.707106781f, 1.0f, 0.707106781f, -8.57252759e-16f, -0.707106781f, -1.0f, -0.707106781f,
};
static const float s_w2_r[225] = {
    1.0f, 1.0f, 1.0f, 1.0f, 1.0f, 1.0f, 1.0f, 1.0f,
    1.0f, 1.0f, 1.0f, 1.0f, 1.0f, 1.0f, 1.0f, 1.0f,
    0.913545458f, 0.669130606f, 0.309016994f, -0.104528463f, -0.5f, -0.809016994f, -0.978147601f, -0.978147601f,
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    0.913545458f,
};
static const float s_w2_i[225] = {
    -0.0f, -0.0f, -0.0f, -0.0f, -0.0f, -0.0f, -0.0f, -0.0f,
    -0.0f, -0.0f, -0.0f, -0.0f, -0.0f, -0.0f, -0.0f, -0.0f,
    -0.406736643f, -0.743144825f, -0.951056516f, -0.994521895f, -0.866025404f, -0.587785252f, -0.207911691f, 0.207911691f,
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    -0.406736643f,
};
static const float s_tw_r[120] = {
    1.0f, 1.0f, 1.0f, 1.0f, 1.0f, 1.0f, 1.0f, 1.0f,
    1.0f, 0.998629535f, 0.994521895f, 0.987688341f, 0.978147601f, 0.965925826f, 0.951056516f, 0.933580426f,
    1.0f, 0.994521895f, 0.978147601f, 0.951056516f, 0.913545458f, 0.866025404f, 0.809016994f, 0.743144825f,
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    1.0f, 0.743144825f, 0.104528463f, -0.587785252f, -0.978147601f, -0.866025404f, -0.309016994f, 0.406736643f,
};
static const float s_tw_i[120] = {
    -0.0f, -0.0f, -0.0f, -0.0f, -0.0f, -0.0f, -0.0f, -0.0f,
    -0.0f, -0.0523359562f, -0.104528463f, -0.156434465f, -0.207911691f, -0.258819045f, -0.309016994f, -0.35836795f,
    -0.0f, -0.104528463f, -0.207911691f, -0.309016994f, -0.406736643f, -0.5f, -0.587785252f, -0.669130606f,
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    -0.0f, -0.669130606f, -0.994521895f, -0.809016994f, -0.207911691f, 0.5f, 0.951056516f, 0.913545458f,
};
static const float s_rot_r[120] = {
    0.999998661f, 0.999891571f, 0.999613155f, 0.99916346f, 0.998542563f, 0.997750572f, 0.996787621f, 0.995653875f,
    0.99434953f, 0.992874808f, 0.991229961f, 0.989415273f, 0.987431053f, 0.985277642f, 0.982955409f, 0.980464752f,
    0.977806097f, 0.9749799f, 0.971986645f, 0.968826845f, 0.965501042f, 0.962009805f, 0.958353733f, 0.954533451f,
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    0.102901041f, 0.0898721149f, 0.0768277893f, 0.0637702996f, 0.0507018832f, 0.0376247792f, 0.0245412285f, 0.0114534728f,
};
static const float s_rot_i[120] = {
    -0.00163624544f, -0.0147256833f, -0.027812598f, -0.0408947472f, -0.0539698892f, -0.0670357838f, -0.0800901921f, -0.0931308775f,
    -0.106155605f, -0.119162144f, -0.132148265f, -0.145111742f, -0.158050356f, -0.170961889f, -0.183844128f, -0.196694866f,
    -0.209511902f, -0.222293039f, -0.235036087f, -0.247738863f, -0.26039919f, -0.273014899f, -0.285583829f, -0.298103825f,
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    -0.994691598f, -0.995953314f, -0.997044378f, -0.997964603f, -0.998713832f, -0.999291937f, -0.999698819f, -0.999934407f,
};
